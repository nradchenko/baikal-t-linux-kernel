## Documentation/devicetree/bindings/memory-controllers/baikal,bt1-ddrc.yaml
```yaml
# SPDX-License-Identifier: (GPL-2.0-only OR BSD-2-Clause)
%YAML 1.2
---
$id: http://devicetree.org/schemas/memory-controllers/baikal,bt1-ddrc.yaml#
$schema: http://devicetree.org/meta-schemas/core.yaml#

title: Baikal-T1 DDR Controller

maintainers:
  - Serge Semin <fancer.lancer@gmail.com>

description:
  Baikal-T1 DDRC is based on the DW uMCTL2 DDRC IP-core v2.51a with DDR2
  and DDR3 protocol capability, 32-bit data bus + 8-bit ECC + up to 2
  SDRAM ranks. There are individual IRQs for each ECC and DFI events.
  The dedicated scrubber clock source is absent since it's fully
  synchronous to the core clock.

allOf:
  - $ref: /schemas/memory-controllers/snps,dw-umctl2-common.yaml#

properties:
  compatible:
    const: baikal,bt1-ddrc

  reg:
    maxItems: 1

  interrupts:
    maxItems: 4

  interrupt-names:
    items:
      - const: dfi_e
      - const: ecc_ce
      - const: ecc_ue
      - const: ecc_sbr

  clocks:
    maxItems: 3

  clock-names:
    items:
      - const: pclk
      - const: aclk
      - const: core

  resets:
    maxItems: 2

  reset-names:
    items:
      - const: arst
      - const: core

required:
  - compatible
  - reg
  - clocks
  - clock-names
  - interrupts
  - interrupt-names

additionalProperties: false

examples:
  - |
    #include <dt-bindings/interrupt-controller/mips-gic.h>
    #include <dt-bindings/clock/bt1-ccu.h>
    #include <dt-bindings/reset/bt1-ccu.h>

    memory-controller@1f042000 {
      compatible = "baikal,bt1-ddrc";
      reg = <0x1f042000 0x1000>;

      interrupts = <GIC_SHARED 96 IRQ_TYPE_LEVEL_HIGH>,
                   <GIC_SHARED 97 IRQ_TYPE_LEVEL_HIGH>,
                   <GIC_SHARED 98 IRQ_TYPE_LEVEL_HIGH>,
                   <GIC_SHARED 99 IRQ_TYPE_LEVEL_HIGH>;
      interrupt-names = "dfi_e", "ecc_ce", "ecc_ue", "ecc_sbr";

      clocks = <&ccu_sys CCU_SYS_APB_CLK>,
               <&ccu_axi CCU_AXI_DDR_CLK>,
               <&ccu_pll CCU_DDR_PLL>;
      clock-names = "pclk", "aclk", "core";

      resets = <&ccu_axi CCU_AXI_DDR_RST>,
               <&ccu_sys CCU_SYS_DDR_INIT_RST>;
      reset-names = "arst", "core";
    };
...
```

## Documentation/devicetree/bindings/memory-controllers/snps,dw-umctl2-common.yaml
```yaml
# SPDX-License-Identifier: (GPL-2.0-only OR BSD-2-Clause)
%YAML 1.2
---
$id: http://devicetree.org/schemas/memory-controllers/snps,dw-umctl2-common.yaml#
$schema: http://devicetree.org/meta-schemas/core.yaml#

title: Synopsys DesignWare Universal Multi-Protocol Memory Controller

maintainers:
  - Krzysztof Kozlowski <krzk@kernel.org>
  - Manish Narani <manish.narani@xilinx.com>
  - Michal Simek <michal.simek@xilinx.com>

description:
  Synopsys DesignWare Enhanced uMCTL2 DDR Memory Controller is capable of
  working with the memory devices supporting up to (LP)DDR4 protocol. It can
  be equipped with SEC/DEC ECC feature if DRAM data bus width is either
  16-bits or 32-bits or 64-bits wide.

select: false

properties:
  interrupts:
    description:
      DW uMCTL2 DDRC IP-core provides individual IRQ signal for each event":"
      ECC Corrected Error, ECC Uncorrected Error, ECC Address Protection,
      Scrubber-Done signal, DFI Parity/CRC Error. Some platforms may have the
      signals merged before they reach the IRQ controller or have some of them
      absent in case if the corresponding feature is unavailable/disabled.
    minItems: 1
    maxItems: 5

  interrupt-names:
    minItems: 1
    maxItems: 5
    oneOf:
      - description: Common ECC CE/UE/Scrubber/DFI Errors IRQ
        items:
          - const: ecc
      - description: Individual ECC CE/UE/Scrubber/DFI Errors IRQs
        items:
          enum: [ ecc_ce, ecc_ue, ecc_ap, ecc_sbr, dfi_e ]

  reg:
    maxItems: 1

  clocks:
    description:
      A standard set of the clock sources contains CSRs bus clock, AXI-ports
      reference clock, DDRC core clock, Scrubber standalone clock
      (synchronous to the DDRC clock).
    minItems: 1
    maxItems: 4

  clock-names:
    minItems: 1
    maxItems: 4
    items:
      enum: [ pclk, aclk, core, sbr ]

  resets:
    description:
      Each clock domain can have separate reset signal.
    minItems: 1
    maxItems: 4

  reset-names:
    minItems: 1
    maxItems: 4
    items:
      enum: [ prst, arst, core, sbr ]

additionalProperties: true

...
```

## Documentation/devicetree/bindings/mfd/baikal,bt1-boot-con.yaml
```yaml
# SPDX-License-Identifier: (GPL-2.0 OR BSD-2-Clause)
# Copyright (C) 2022 BAIKAL ELECTRONICS, JSC
%YAML 1.2
---
$id: "http://devicetree.org/schemas/mfd/baikal,bt1-boot-con.yaml#"
$schema: "http://devicetree.org/meta-schemas/core.yaml#"

title: Baikal-T1 SoC Boot Controller

maintainers:
  - Serge Semin <fancer.lancer@gmail.com>

description:
  Baikal-T1 SoC is equipped with a Boot Controller which is responsible for
  the SoC proper boot up procedure. Depending on the external pin state the
  system can boot up either from the internal ROM or from the externally attached
  SPI flash (at least of 16MB) or from the internal SRAM (the 64KB of executional
  code is pre-loaded from the external SPI flash).

allOf:
  - $ref: /schemas/mfd/syscon.yaml#

properties:
  compatible:
    items:
      - const: baikal,bt1-boot-con
      - const: syscon
      - const: simple-mfd

  reg:
    items:
      - description:
          Baikal-T1 Boot Controller CSR space. It doesn't include many
          settings':' corrent boot mode, SPI controller access mux, SRAM
          access mux and device ID.
      - description: Mirrored first 4MB of the boot SPI flash memory

  reg-names:
    items:
      - const: boot
      - const: mirror

  "#address-cells":
    const: 1

  "#size-cells":
    const: 1

  ranges: true

  little-endian: true

  mux-controller:
    $ref: /schemas/mux/reg-mux.yaml#

  rom@1bfc0000:
    $ref: /schemas/mtd/mtd-physmap.yaml#

  spi@1f040100:
    $ref: /schemas/spi/snps,dw-apb-ssi.yaml#

required:
  - compatible
  - reg

unevaluatedProperties: false

examples:
  - |
    syscon@1f04d000 {
      compatible = "baikal,bt1-boot-con", "syscon", "simple-mfd";
      reg = <0x1f040000 0x1000>,
            <0x1fc00000 0x400000>;
      reg-names = "boot", "mirror";
      #address-cells = <1>;
      #size-cells = <1>;
      ranges;

      little-endian;
      reg-io-width = <4>;

      mux-controller {
        compatible = "mmio-mux";
        #mux-control-cells = <1>;

        mux-reg-masks = <0x0 0x100>, <0x4 0x1>;
        idle-states = <0x1>, <0x0>;
      };

      rom@1bfc0000 {
        compatible = "baikal,bt1-int-rom", "mtd-rom";
        reg = <0x1bfc0000 0x10000>;

        no-unaligned-direct-access;
        bank-width = <4>;
      };

      spi@1f040100 {
        compatible = "baikal,bt1-sys-ssi";
        reg = <0x1f040100 0x900>,
              <0x1c000000 0x1000000>;
        reg-names = "config", "map";
        #address-cells = <1>;
        #size-cells = <0>;

        mux-controls = <&boot_mux 0>;

        clocks = <&ccu_sys 1>;
        clock-names = "ssi_clk";
      };
    };
...
```

## Documentation/devicetree/bindings/mfd/baikal,bt1-sys-con.yaml
```yaml
# SPDX-License-Identifier: (GPL-2.0 OR BSD-2-Clause)
# Copyright (C) 2022 BAIKAL ELECTRONICS, JSC
%YAML 1.2
---
$id: "http://devicetree.org/schemas/mfd/baikal,bt1-sys-con.yaml#"
$schema: "http://devicetree.org/meta-schemas/core.yaml#"

title: Baikal-T1 SoC System Controller

maintainers:
  - Serge Semin <fancer.lancer@gmail.com>

description:
  Baikal-T1 SoC is equipped with a System Controller which is responsible for
  the SoC components setting up and consists of the next sub-blocks':'
  PLL/AXI-bus/System devices Clocks Control Units, P5600 CM2 L2-RAM controller,
  CPU cores reboot flag, persistent across reboots register, indirectly
  accessible DW APB I2C controller, Boot Controller with a pre-installed memory
  mapped firmware and a resource limited DW APB SSI, which is also can be used
  to transparently access an external SPI flash by means of a dedicated IO
  memory region.

allOf:
  - $ref: /schemas/mfd/syscon.yaml#

properties:
  compatible:
    items:
      - const: baikal,bt1-sys-con
      - const: syscon
      - const: simple-mfd

  reg:
    description:
      Baikal-T1 System Controller CSR space. It includes CCU (Clock Control
      Unit), L2 settings, Reboot flag and Reboot tolerant register, System I2C
      controller CSRs.
    maxItems: 1

  reg-names:
    const: sys

  "#address-cells":
    const: 1

  "#size-cells":
    const: 1

  ranges: true

  little-endian: true

  clock-controller@1f04d000:
    $ref: /schemas/clock/baikal,bt1-ccu-pll.yaml#

  clock-controller@1f04d030:
    $ref: /schemas/clock/baikal,bt1-ccu-div.yaml#

  clock-controller@1f04d060:
    $ref: /schemas/clock/baikal,bt1-ccu-div.yaml#

  l2@1f04d028:
    $ref: /schemas/cache/baikal,bt1-l2-ctl.yaml#

  reboot:
    $ref: /schemas/power/reset/syscon-reboot.yaml#

  reboot-mode:
    $ref: /schemas/power/reset/syscon-reboot-mode.yaml#

  i2c@1f04d100:
    $ref: /schemas/i2c/snps,designware-i2c.yaml#

required:
  - compatible
  - reg

unevaluatedProperties: false

examples:
  - |
    syscon@1f04d000 {
      compatible = "baikal,bt1-sys-con", "syscon", "simple-mfd";
      reg = <0x1f04d000 0x1000>;
      #address-cells = <1>;
      #size-cells = <1>;
      ranges;

      little-endian;
      reg-io-width = <4>;

      clock-controller@1f04d000 {
        compatible = "baikal,bt1-ccu-pll";
        reg = <0x1f04d000 0x028>;
        #clock-cells = <1>;

        clocks = <&clk25m>;
        clock-names = "ref_clk";
      };

      clock-controller@1f04d030 {
        compatible = "baikal,bt1-ccu-axi";
        reg = <0x1f04d030 0x030>;
        #clock-cells = <1>;
        #reset-cells = <1>;

        clocks = <&ccu_pll 1>,
                 <&ccu_pll 2>,
                 <&ccu_pll 3>;
        clock-names = "sata_clk", "pcie_clk", "eth_clk";
      };

      l2@1f04d028 {
        compatible = "baikal,bt1-l2-ctl";
        reg = <0x1f04d028 0x004>;

        baikal,l2-ws-latency = <0>;
        baikal,l2-tag-latency = <0>;
        baikal,l2-data-latency = <1>;
      };

      i2c@1f04d100 {
        compatible = "baikal,bt1-sys-i2c";
        reg = <0x1f04d100 0x010>;
        #address-cells = <1>;
        #size-cells = <0>;

        interrupts = <0 32 4>;

        clocks = <&ccu_sys 1>;
      };
    };
...
```

## arch/mips/baikal-t1/Kconfig
```kconfig
# SPDX-License-Identifier: GPL-2.0-only
#
# Copyright (C) 2020 BAIKAL ELECTRONICS, JSC
#
# Baikal-T1 platform configs
#
if MIPS_BAIKAL_T1

config BT1_DEBUG
	bool "Enable SoC/kernel debug options"
	select EXPERT
	select DEBUG_KERNEL
	select DEBUG_ZBOOT
	select DEBUG_MEMORY_INIT
	select DEBUG_HIGHMEM if HIGHMEM
	select DEBUG_STACKOVERFLOW
	select RCU_TRACE
	select EDAC_DEBUG if EDAC
	select SCACHE_DEBUGFS
	select GENERIC_IRQ_DEBUGFS
	select CMA_DEBUGFS if CMA
	select MIPS_CPS_NS16550_BOOL if MIPS_CPS
	help
	  Use this option if you at the process of the kernel drivers
	  platform code development.

config BT1_EARLY_UART
	int "Default UART device for early printk and zboot"
	range 0 1
	default 0
	help
	  There are two DW APB UART-based serial interfaces available on
	  Baikal-T1 SoC. By this option you can select one of them to be used
	  to print early logs and zboot debug symbols. Note having both
	  EARLY_PRINTK and SERIAL_EARLYCON configs enabled is prune to
	  getting duplicated log messages if both of these sub-systems are
	  using the same console. In case if you need to have the logs on both
	  UART devices make sure that this parameter and 'stdout-path' DT
	  property point to the different serial devices.

config BT1_CPU_FEATURE_OVERRIDES
	bool "Declare CPU features"
	help
	  By default nearly all the MIPS IP-core features are detectable on
	  runtime. Corresponding cpu_has_* flags are constantly checked in
	  the code to enabled/disable corresponding platform features. Since
	  we indend to build the Baikal-T1 CPU specific kernel there is no
	  need in such flexibility, so we can freely define these flags with
	  values known at build-time. By doing so we not only decrease the
	  kernel size, but also speed it up.

	  If unsure, say N.

config BT1_SWIOTLB_SIZE
	int "SWIOTLB size in MiB" if SWIOTLB
	range 4 64
	default 8
	help
	  Due to the Baikal-T1 main interconnect controller invalid synthesis
	  parameters, SATA/USB/GMACx aren't able to access the physical memory
	  higher than 4GiB. So in case if XPA is enabled and bootloader states
	  there is more than 4GiB of physical memory, we need to have the
	  SWIOTLB declared. Since by default SWIOTLB consumes too much memory
	  we create a custom table with compile-time configurable buffer size.

choice
	prompt "Baikal-T1 SoC based boards devicetree"
	default BT1_DTB_NONE
	help
	  Select a devicetree of the board with Baikal-T1 SoC installed.

	config BT1_DTB_NONE
	bool "None"

	config BT1_DTB_ALL
	bool "All"

	config BT1_DTB_GENERIC
	bool "Generic Baikal-T1 Board"
	help
	  This option provides a dtb for a generic board. It just activates all
	  the Baikal-T1 SoC peripherals. So all the run-time detectable devices
	  will work out-of-box while undetectable platform devices will be left
	  untouched.

	config BT1_DTB_BFK
	bool "Baikal Electronics BFK"
	help
	  This option provides a dtb for the Baikal Electronics BFK boards.
	  It's a Baikal-T1 SoC evaluation board specifically designed for
	  the SoC-based software prototyping.

endchoice

menu "Baikal-T1 Errata"

config BT1_ERRATA_JR_LS_BUG
	bool "Fix load/store bonding and JR prediction bug"
	help
	  Early Baikal-T1 chips had problems when load/store bonding and JR
	  prediction were enabled. Switch these features off if you are using
	  the engineering version of the chip.

	  If unsure, say N.

config BT1_ERRATA_GMAC_SPEED_INV_BUG
	bool "Fix DW GMAC 10/100Mbit link speed bug"
	help
	  DW GMAC on early Baikal-T1 chip releases had an inverted 10/100Mbit
	  MAC speed settings. So when 10Mbit link is requested then 100Mbit MAC
	  link speed should be setup and vise-versa.

	  If unsure, say N.

endmenu

endif # MIPS_BAIKAL_T1
```
